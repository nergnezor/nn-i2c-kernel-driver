&i2c_1 {
    neonode_zforceair@50 { //Slave driver and slave Address
        compatible ="neonode,zforceair";//Manufacture, model
        reg = <0x50>; //Slave Address
        interrupt-parent = <&msm_gpio>; //GPIO handler
        interrupts = <36 0x1>; //GPIO# to gpio_irq #
        neonode_zforceair,irq-gpio = <&msm_gpio 36 0x00>; //Pass a GPIO
    };
};